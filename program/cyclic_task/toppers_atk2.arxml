AUTOSAR XML (schema 4-0-3)
package /Ecuc
  module config Os: ecuc-def-edition=4.2.0, implementation-config-variant=VARIANT-PRE-COMPILE
    OsInclude: OsIncludeFileName=toppers_atk2.h
    AppMode1 (OsAppMode)
    OsOS: OsStackMonitoring=true, OsUseGetServiceId=true, OsUseParameterAccess=true, OsScalabilityClass=SC1, OsStatus=EXTENDED
      OsHooks: OsErrorHook=false, OsPostTaskHook=false, OsPreTaskHook=false, OsProtectionHook=false, OsShutdownHook=false, OsStartupHook=true
      OsHookStack: OsHookStackSize=512
    cyclic_task (OsTask): OsTaskActivation=1, OsTaskPriority=14, OsTaskStackSize=592, OsTaskSchedule=NON
    CyclicTaskCycAlarm (OsAlarm): OsAlarmCounterRef=MAIN_HW_COUNTER
      OsAlarmAction
        OsAlarmActivateTask: OsAlarmActivateTaskRef=cyclic_task
      OsAlarmAutostart: OsAlarmAlarmTime=16000000, OsAlarmCycleTime=16000000, OsAlarmAutostartType=ABSOLUTE, OsAlarmAppModeRef=AppMode1
